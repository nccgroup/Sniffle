/*
 * Copyright (c) 2018, Texas Instruments Incorporated
 * Copyright (c) 2020-2021, NCC Group plc
 * All rights reserved.
 *
 * Redistribution and use in source and binary forms, with or without
 * modification, are permitted provided that the following conditions
 * are met:
 *
 * *  Redistributions of source code must retain the above copyright
 *    notice, this list of conditions and the following disclaimer.
 *
 * *  Redistributions in binary form must reproduce the above copyright
 *    notice, this list of conditions and the following disclaimer in the
 *    documentation and/or other materials provided with the distribution.
 *
 * *  Neither the name of Texas Instruments Incorporated nor the names of
 *    its contributors may be used to endorse or promote products derived
 *    from this software without specific prior written permission.
 *
 * THIS SOFTWARE IS PROVIDED BY THE COPYRIGHT HOLDERS AND CONTRIBUTORS "AS IS"
 * AND ANY EXPRESS OR IMPLIED WARRANTIES, INCLUDING, BUT NOT LIMITED TO,
 * THE IMPLIED WARRANTIES OF MERCHANTABILITY AND FITNESS FOR A PARTICULAR
 * PURPOSE ARE DISCLAIMED. IN NO EVENT SHALL THE COPYRIGHT OWNER OR
 * CONTRIBUTORS BE LIABLE FOR ANY DIRECT, INDIRECT, INCIDENTAL, SPECIAL,
 * EXEMPLARY, OR CONSEQUENTIAL DAMAGES (INCLUDING, BUT NOT LIMITED TO,
 * PROCUREMENT OF SUBSTITUTE GOODS OR SERVICES; LOSS OF USE, DATA, OR PROFITS;
 * OR BUSINESS INTERRUPTION) HOWEVER CAUSED AND ON ANY THEORY OF LIABILITY,
 * WHETHER IN CONTRACT, STRICT LIABILITY, OR TORT (INCLUDING NEGLIGENCE OR
 * OTHERWISE) ARISING IN ANY WAY OUT OF THE USE OF THIS SOFTWARE,
 * EVEN IF ADVISED OF THE POSSIBILITY OF SUCH DAMAGE.
 */

/* ======== RF ======== */
var RF = scripting.addModule("/ti/drivers/RF");

/* if an antenna component exists, assign it to the rf instance */
if (system.deviceData.board && system.deviceData.board.components.RF) {
    RF.$hardware = system.deviceData.board.components.RF;
}

var ble5 = scripting.addModule("/ti/devices/radioconfig/custom");
ble5.ble = ["bt5le1m"];
ble5.radioConfigbt5le1m.codeExportConfig.symGenMethod = "Legacy";
ble5.radioConfigbt5le1m.codeExportConfig.appOverride = "sniffle_overrides.h";
ble5.radioConfigbt5le1m.codeExportConfig.appOverrideMacro = "BLE_APP_OVERRIDES";
if (system.deviceData.deviceId.startsWith("CC1352P")) {
    ble5.radioConfigbt5le1m.codeExportConfig.cmdList_ble = [
        "cmdBle5GenericRx",
        "cmdBle5Master",
        "cmdBle5RadioSetupPa",
        "cmdBle5Slave",
        "cmdBleAdv",
        "cmdBle5Initiator",
        "cmdBle5Scanner",
        "cmdFs"];
} else {
    ble5.radioConfigbt5le1m.codeExportConfig.cmdList_ble = [
        "cmdBle5GenericRx",
        "cmdBle5Master",
        "cmdBle5RadioSetup",
        "cmdBle5Slave",
        "cmdBleAdv",
        "cmdBle5Initiator",
        "cmdBle5Scanner",
        "cmdFs"];
}

/* ======== LED Red ======== */
var GPIO = scripting.addModule("/ti/drivers/GPIO");  // Add a GPIO module for use by LEDs
var LED_R = GPIO.addInstance();                      // Add an a GPIO module instance for LED_R

/* if a red LED component exists, assign it to the LED_R instance */
if (system.deviceData.board && system.deviceData.board.components.LED_RED) {
    LED_R.$hardware = system.deviceData.board.components.LED_RED;
}
else
{
    LED_R.mode = "Output";  // Set the LED pin to output
}

LED_R.$name = "CONFIG_GPIO_RLED";                     // Descriptive name for the LED_R GPIO
LED_R.pinInstance.$name = "CONFIG_PIN_RLED";          // Descriptive name for LED_R PIN

/* ======== UART ======== */
var UART = scripting.addModule("/ti/drivers/UART");
var uart = UART.addInstance();
uart.$hardware = system.deviceData.board.components.XDS110UART;
uart.$name = "CONFIG_UART_0";
uart.ringBufferSize = 512;

/* ======== Device ======== */
var device = scripting.addModule("ti/devices/CCFG");
const ccfgSettings = system.getScript("/ti/common/lprf_ccfg_settings.js").ccfgSettings;
for(var setting in ccfgSettings)
{
    device[setting] = ccfgSettings[setting];
}
