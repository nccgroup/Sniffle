/*
 * Copyright (c) 2018, Texas Instruments Incorporated
 * Copyright (c) 2020-2022, NCC Group plc
 * All rights reserved.
 *
 * Redistribution and use in source and binary forms, with or without
 * modification, are permitted provided that the following conditions
 * are met:
 *
 * *  Redistributions of source code must retain the above copyright
 *    notice, this list of conditions and the following disclaimer.
 *
 * *  Redistributions in binary form must reproduce the above copyright
 *    notice, this list of conditions and the following disclaimer in the
 *    documentation and/or other materials provided with the distribution.
 *
 * *  Neither the name of Texas Instruments Incorporated nor the names of
 *    its contributors may be used to endorse or promote products derived
 *    from this software without specific prior written permission.
 *
 * THIS SOFTWARE IS PROVIDED BY THE COPYRIGHT HOLDERS AND CONTRIBUTORS "AS IS"
 * AND ANY EXPRESS OR IMPLIED WARRANTIES, INCLUDING, BUT NOT LIMITED TO,
 * THE IMPLIED WARRANTIES OF MERCHANTABILITY AND FITNESS FOR A PARTICULAR
 * PURPOSE ARE DISCLAIMED. IN NO EVENT SHALL THE COPYRIGHT OWNER OR
 * CONTRIBUTORS BE LIABLE FOR ANY DIRECT, INDIRECT, INCIDENTAL, SPECIAL,
 * EXEMPLARY, OR CONSEQUENTIAL DAMAGES (INCLUDING, BUT NOT LIMITED TO,
 * PROCUREMENT OF SUBSTITUTE GOODS OR SERVICES; LOSS OF USE, DATA, OR PROFITS;
 * OR BUSINESS INTERRUPTION) HOWEVER CAUSED AND ON ANY THEORY OF LIABILITY,
 * WHETHER IN CONTRACT, STRICT LIABILITY, OR TORT (INCLUDING NEGLIGENCE OR
 * OTHERWISE) ARISING IN ANY WAY OUT OF THE USE OF THIS SOFTWARE,
 * EVEN IF ADVISED OF THE POSSIBILITY OF SUCH DAMAGE.
 */

/* ======== TIRTOS7 ======== */
if (system.getRTOS() === "tirtos7") {
    const tirtos7_release_syscfg_js = system.getScript("tirtos7_release.syscfg.js");
}

/* ======== Components ======== */
var Components = system.deviceData.board.components;

/* ======== Power ======== */
var power = scripting.addModule("/ti/drivers/Power");
power.policyFunction = "PowerCC26XX_doWFI";

/* ======== RF ======== */
var RF = scripting.addModule("/ti/drivers/RF");

/* if an antenna component exists, assign it to the rf instance */
if (system.deviceData.board && system.deviceData.board.components.RF) {
    RF.$hardware = system.deviceData.board.components.RF;
}

var ble5 = scripting.addModule("/ti/devices/radioconfig/custom");
ble5.ble = ["bt5le1m"];
ble5.radioConfigbt5le1m.codeExportConfig.symGenMethod = "Legacy";
ble5.radioConfigbt5le1m.codeExportConfig.appOverride = "sniffle_overrides.h";
ble5.radioConfigbt5le1m.codeExportConfig.appOverrideMacro = "BLE_APP_OVERRIDES";
if (system.deviceData.deviceId[6] == "P") {
    ble5.radioConfigbt5le1m.codeExportConfig.cmdList_ble = [
        "cmdBle5GenericRx",
        "cmdBle5Master",
        "cmdBle5RadioSetupPa",
        "cmdBle5Slave",
        "cmdBleAdv",
        "cmdBle5Initiator",
        "cmdBle5Scanner",
        "cmdBleScanner",
        "cmdFs"];
} else {
    ble5.radioConfigbt5le1m.codeExportConfig.cmdList_ble = [
        "cmdBle5GenericRx",
        "cmdBle5Master",
        "cmdBle5RadioSetup",
        "cmdBle5Slave",
        "cmdBleAdv",
        "cmdBle5Initiator",
        "cmdBle5Scanner",
        "cmdBleScanner",
        "cmdFs"];
}

/* ======== RF Design ======== */
var rfDesign = scripting.addModule("ti/devices/radioconfig/rfdesign");
const rfDesignSettings = system.getScript("/ti/common/lprf_rf_design_settings.js").rfDesignSettings;
for(var setting in rfDesignSettings)
{
    rfDesign[setting] = rfDesignSettings[setting];
}

/* ======== LED ======== */
var LED = scripting.addModule("/ti/drivers/apps/LED");
var led0 = LED.addInstance();
led0.$hardware = Components.LED0;
var led1 = LED.addInstance();
led1.$hardware = Components.LED1;

/* ======== UART ======== */
var UART2 = scripting.addModule("/ti/drivers/UART2");
var uart2 = UART2.addInstance();
uart2.$hardware = system.deviceData.board.components.XDS110UART;
uart2.$name = "CONFIG_UART2_0";
uart2.rxRingBufferSize = 512;

/* ======== Device ======== */
var device = scripting.addModule("ti/devices/CCFG");
const ccfgSettings = system.getScript("/ti/common/lprf_ccfg_settings.js").ccfgSettings;
for(var setting in ccfgSettings)
{
    device[setting] = ccfgSettings[setting];
}

/* Set CCFG to allow flashing with bootloader so firmware updates are possible
 * on devices without an on-board debugger */
device.enableBootloader = true;
device.enableBootloaderBackdoor = true;
